## conf/distro/mume.conf
```bitbake
require conf/distro/poky.conf

DISTRO = "mume"
DISTRO_NAME = "MUME!"

MAINTAINER = "Urs Fässler"

POKY_DISTRO_FEATURES = "ipv4 ipv6 systemd"
DISTRO_FEATURES = "${DISTRO_FEATURES_LIBC_DEFAULT} ${POKY_DISTRO_FEATURES}"
DISTRO_FEATURES_remove += "sysvinit bluez5"

VIRTUAL-RUNTIME_init_manager = "systemd"

PACKAGE_CLASSES = "package_ipk"

# Disable python usage in opkg-utils
PACKAGECONFIG_pn-opkg-utils = ""

PREFERRED_PROVIDER_u-boot = "u-boot-ti-staging"
PREFERRED_PROVIDER_linux = "linux-mainline"
PREFERRED_PROVIDER_virtual/kernel = "linux-mainline"

#TODO move this line to a nicer place (in addition to teh generation of uEnv.txt in the kernel recipe)
IMAGE_BOOT_FILES += "uEnv.txt"
```
